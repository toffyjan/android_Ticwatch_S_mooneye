## arch/arm/mach-mt2601/Kconfig
```kconfig
config MAX_DRAM_SIZE_SUPPORT
	hex "The maximum size of the DRAM can be supported in the kernel"
	depends on ARCH_MT2601
	default 0x10000000
	help
	  Define the maximum size of the kernel can be supported.
	  If will modify the memory size if it size is smaller than
          the memory size passed by the boot loader to the MAX_DRAM_SIZE_SUPPORT.
   	  Notice that the maximum DRAM size is including the memory size
	  reserved for the modem and the PMEM.
```

## drivers/misc/mediatek/btcvsd/Kconfig
```kconfig
config MTK_BTCVSD
	tristate "MediaTek BTCVSD driver"
	default n
	---help---
	  BTCVSD driver support for MediaTek SOC.
	  If you want to use MediaTek BTCVSD driver, say Y here.
	  If unsure, say N.
```

## drivers/misc/mediatek/i2c/Kconfig
```kconfig
config MTK_I2C
	tristate "MediaTek I2C adapter"
	depends on ARCH_MT2601
	default y
	help
	  This selects the MediaTek(R) Integrated Inter Circuit bus driver.
	  MediaTek(R) I2C bus adapter is the base for some other I2C client, eg: touch, sensors.
	  If you want to use MediaTek(R) I2C interface, say Y or M here.
	  If unsure, say N.

config MTK_I2C_EXTENSION
	def_bool y if ARCH_MT2601
	help
	  Select this if your platform need MTK i2c extension.
```

## drivers/misc/mediatek/sensorhub/Kconfig
```kconfig
config CUSTOM_KERNEL_SENSORHUB
	bool "CUSTOM_KERNEL_SENSORHUB"
	help
	    sensorhub support

config INPUT_CWSTM32
	bool "CONFIG_INPUT_CWSTM32"
	help
	    Cywee on STM32
```

## drivers/misc/mediatek/sound/Kconfig
```kconfig
config MTK_SOUND
	tristate "MediaTek Sound driver"
	default n
	---help---
	  Sound driver support for MediaTek SOC.
	  If you want to use MediaTek Sound driver, say Y here.
	  If unsure, say N.
```

## drivers/power/mediatek/Kconfig
```kconfig
 menuconfig MEDIATEK_CHARGING_SOLUTION
	bool "MediaTek Propritary Configuration for Charging"
	help
	  Check this to enable MediaTek charging configuration.

config MTK_SMART_BATTERY
	tristate "MediaTek Smart Battery Driver"
	default n
	help
	  Check this to enable MediaTek smart battery driver.
	  The driver supports charging control flow.
	  It maintais both charger and battery status.
	  It also includes Mediatek gas gauge.

config MTK_CHARGING_AUTO_BOOT_SUPPORT
	tristate "MediaTek off-mode charging and aut-boot feature"
	depends on MTK_SMART_BATTERY
	default n

config MTK_GAUGE_VERSION
	int "MediaTek Fuel Gauge version"
	default 20
	help
	  Select MTK Gauge Master version
	  10: Gauge Master 1.0
	  20: Gauge Master 2.0
	  30: Gauge Master 3.0

config MTK_ADDITIONAL_BATTERY_TABLE
	bool "Enable the fifth battery table"
	default y
	help
	  Set Yes to enable the fifth battery table
	  Table number is five.
	  Set No to disable the fifth battery table
	  Table number is four.
```
